/*
 * Модуль на esp32 для обмена данными с сервером                        
 * 
 */
 
 // Подключаем необходимые библиотеки -----------------------------------------------------------------------------------------------------
#include "WiFi.h"      // Библиотека работы с сетью вайфай
#include <HTTPClient.h>// Библиотека для работы с http


// Переменные   ---------------------------------------------------------------------------------------------------------------------
const char* ssid = "111111";           // Логин для подключения к сети wifi
const char* password =  "111111";      // Пароль для подключения к сети wifi
const char* host = "http://111111";    // Адрес запроса на тестовую страницу
const int httpsPort = 443;             // Номер порта

uint8_t data[12];//  Переменная массив для отправки данных
                

// Инициализация функция----------------------------------------------------------------------------------------------------------
void setup() 
{  
  Serial.begin(9600);                     // Инициализируем серийный порт для отладки, скорость 9600
  Serial2.begin(9600, SERIAL_8N1, 16, 17);// Инициализируем серийный порт для обменна данными с ардуино, скорость 9600

  WiFi.begin(ssid, password);             // Запуск подключения вайфай, логин и пароль сети

  // Подключение к сети wifi при первом включении ---------------------------------------------------------------
  int count = 0;                          // Переменная для перебора количества попоыток подключения к сети
  while(WiFi.status() != WL_CONNECTED)    // Ожидание подключения к сети 
  {
    count++;                               // Итерация переменной
    delay(500);                            // Небольшая пауза между попытками подключения
    Serial.println("Connecting to WiFi..");// Выводим надпись в отладочный порт                      
    if(count == 10)                        // Если количество неудачных подключений достигло 10
    {
        // Отправляем сообщение на шлюз что сеть не подключена 
        Serial.println("Connecting NO !!!!!!!!!!!");// Выводим надпись        
        break;
    }
  } 
}


// Основной цикл работы --------------------------------------------------------------------------------------------
void loop() 
{
  if(WiFi.status() != WL_CONNECTED)// Если сеть подключена то
  {
      if(Serial2.available() > 0)// Если в серийный порт что то пришло 
      {
           // Отправляем на сервер
           HTTPClient http;    // Объявить объект класса HttpClient 
           http.begin(host);   // Адрес сервера для отправки запроса
           http.addHeader("Content-Type", "text/plain");// Заголовок для текстовых данных
           int data = Serial2.read();// Получаем то что пришло в серийный порт
           String mess = String(data);// Преобразуем в строку для отправки на сервер
           int httpCode = http.POST(mess);// Отправляем строку данных и получаем в ответ код
           String payload = http.getString();// Получаем строку возрата
           http.end();  // Закрывам соединение 
      }
      // Если с сервера что то пришло - то отправляем обратно в серийный порт ( в зависимости от задачи )
  }
  else// Если сеть не подключена
  {
      WiFi.begin(ssid, password);// Запуск подключения вайфай, логин и пароль сети// Подключаем сеть
      delay(5000);// Пауза между попытками подключения 5 секунд
  }
}
