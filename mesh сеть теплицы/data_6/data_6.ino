/*
 * Модуль для управления исполнительными устройствами - два реле для увлажинтеля и полива, драйвер шагового двигателя для привода
 * Распиновка для подключения:                          
 * 
 * Идентификаторы и команды в сети:
 * 2 - включить реле увлажнителя воздуха
 * 3 - выключить реле увлажнителя воздуха
 * 4 - включить реле полива земли
 * 5 - выключить реле полива земли
 * 10 - форточка закрыта
 * 11 - форточка открыта на 30
 * 12 - форточка открыта на 45
 * 13 - форточка открыта на 90
 * 14 - форточка открыта на 110
 * от 50 до 200 - температура воздуха
 * от 200 до 400 - влажность воздуха
 * от 1000 до 3000 - влажность земли аналоговое значение
 * от 3000 до 5000 - уровень воды
 *                         
 */
#include <Gyver433.h>                  //  Подключаем библиотеку для работы с радиомодулем

Gyver433_RX<2, 20> rx;                 //  Указали пин и размер буфера для приема из радио
 
 // Переменные ----------------------------------- 
 //bool water_pomp = false;  // Работа водяной помпы для полива
 //bool air_pomp = false;    // Работа увлажнителя воздуха
 //int vent = false;         // Положение створки вентиляции

 // Инициализация пинов -------------------------
 // Два пина для реле на выход с подтяжкой к земле или питанию в зависимости от типа реле
 // Два пина для степ и дир шагового двигателя - подтяжка зависит от драйвера

void setup() 
{
    attachInterrupt(0, isr, CHANGE);  // Настройка прерывание пина радио по CHANGE

    Serial.begin(9600);               // Включаем серийный порт для отладки   
}
// функция тикер вызывается в прерывании
void isr() 
{
  rx.tickISR();
}
void loop() 
{
  if (rx.gotData()) // если успешно принято больше 0
  {                   
      char data[4];    
      if (rx.readData(data)) 
      {
           Serial.print(data);              
           Serial.println();                                 
      }
      else
      {
           Serial.print("Data error ");
      }
      // Преобразуем полученные данные -------------------------------------------------------------
      int x = atoi(data);
      if(x == 10)// Пришла команда
      {
        // Отработка команды
      }
      else if(x == 11)// Пришла команда
      {
        // Отработка команды
      }
      else if(x == 12)// Пришла команда
      {
        // Отработка команды
      }      
  }
}
