/*
 * Модуль шлюз для распределения, обработки и вывода данных
 * Распиновка для подключения:                          
 * 
 * Идентификаторы и команды в сети:
 * 2 - включить реле увлажнителя воздуха
 * 3 - выключить реле увлажнителя воздуха
 * 4 - включить реле полива земли
 * 5 - выключить реле полива земли
 * 10 - форточка закрыта
 * 11 - форточка открыта на 30
 * 12 - форточка открыта на 45
 * 13 - форточка открыта на 90
 * 14 - форточка открыта на 110
 * от 50 до 200 - температура воздуха
 * от 200 до 400 - влажность воздуха
 * от 1000 до 3000 - влажность земли аналоговое значение
 * от 3000 до 5000 - уровень воды
 * 
 */
#include <LiquidCrystal.h>             //  Подключаем библиотеку LiquidCrystal для работы с LCD дисплеем
#include <Gyver433.h>                  //  Подключаем библиотеку для работы с радиомодулем


LiquidCrystal lcd(9,4,5,6,7,8);        //  Объявляем объект библиотеки, указывая выводы дисплея (RS,E,D4,D5,D6,D7)
Gyver433_RX<2, 20> rx;                 //  Указали пин и размер буфера для приема из радио
Gyver433_TX<3> tx;                     //  Указываем пин для отправки радио
 
 // Переменные -----------------------------------
 //int temp_data[5];       // Массив значений температур
 int temp = 0;             // Среднее значение температуры

 //int hum_air_data[5];    // Массив значений влажности воздуха
 int hum_air = 0;          // Среднее значение влажности воздуха

 //int hum_gr_data[5];     // Массив значений влажности земли
 int hum_gr = 0;           // Среднее значение влажности земли

 //int porog_water_data[5];// Массив значений уровня воды
 int porog_water = 0;      // Среднее значение уровня воды

 //bool water_pomp = false;  // Работа водяной помпы для полива
 //bool air_pomp = false;    // Работа увлажнителя воздуха
 //bool vent = false;        // Положение створки вентиляции

 // Инициализация пинов -------------------------

void setup() 
{
    lcd.begin(20, 4);                 //  Инициируем работу с LCD дисплеем, указывая количество (столбцов, строк)
    lcd.setCursor(0, 0);              //  Устанавливаем курсор в позицию (0 столбец, 0 строка)
    lcd.print("Start programm");      //  Выводим текст "LDC2004", начиная с установленной позиции курсора
    lcd.setCursor(0, 1);              //  Устанавливаем курсор в позицию (0 столбец, 1 строка)
    lcd.print("No data radio");       //  Выводим текст 

    attachInterrupt(0, isr, CHANGE);  // Настройка прерывание пина радио по CHANGE

    Serial.begin(9600);               // Включаем серийный порт для отладки
    
}
// функция тикер вызывается в прерывании
void isr() 
{
  rx.tickISR();
}
void loop() 
{
  if (rx.gotData()) // если успешно принято больше 0
  {                   
      char data[4];    
      if (rx.readData(data)) 
      {
           Serial.print(data);              
           Serial.println();                                 
      }
      else
      {
           Serial.print("Data error ");
      }
      // Преобразуем полученные данные -------------------------------------------------------------
      int x = atoi(data);
      if((x > 50) && (x < 200))// Пришла температура воздуха
      {
        temp = x - 100;
      }
      else if((x > 200) && (x < 400))// Пришла влажность воздуха
      {
        hum_air = x - 300;
      }
      else if((x > 1000) && (x < 3000))// Пришла влажность земли
      {
        hum_gr = (x - 1000)/10;
      }

      // Обрабатываем события ----------------------------------------------------------------------
      // Если порог температуры больше чем - то отправляем команду на привод tx.sendData();
      // Если порог температуры больше чем - то отправляем команду на привод tx.sendData();
      // Если порог температуры больше чем - то отправляем команду на привод tx.sendData();
      // Если порог температуры больше чем - то отправляем команду на привод tx.sendData();
      // Если влажность воздуха больше порога то отправляем команду на реле увлажнителя tx.sendData();
      // Если влажность земли меньше порога то отправляем команду на реле полива tx.sendData();
      
      
      // Выводим данные на экран ------------------------------------------------------------------- 
      lcd.clear();                  // Отчищаем экран
      lcd.setCursor(0, 0);          // На первую строку
      lcd.print("Temperature: ");   // Выводим текст
      lcd.print(temp);              // Выводим данные 
      lcd.print(" C");              // Выводим текст
      
      lcd.setCursor(0, 1);          // На вторую строку
      lcd.print("Air humid: ");     // Выводим текст
      lcd.print(hum_air);           // Выводим данные
      lcd.print(" %");              // Выводим текст
      
      lcd.setCursor(0, 2);          // На третью строку
      lcd.print("Earth humid: ");   // Выводим текст
      lcd.print(hum_gr);            // Выводим данные
      lcd.print(" %");              // Выводим текст
      
      lcd.setCursor(0, 3);          // На четвертую строку
      lcd.print("Water: ");         // Выводим текст
      lcd.print(porog_water);       // Выводим данные
      lcd.print(" %");              // Выводим текст         
  }
}
